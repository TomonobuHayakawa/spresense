## examples/audio_capture_objif/Kconfig
```kconfig
#
# For a description of the syntax of this configuration file,
# see the file kconfig-language.txt in the NuttX tools repository.
#

config EXAMPLES_AUDIO_CAPTURE_OBJIF
	bool "Audio capture (use object if)example"
	default n
	depends on CXD56_AUDIO
	---help---
		Enable the audio capture with object level i/f example

if EXAMPLES_AUDIO_CAPTURE_OBJIF

config EXAMPLES_AUDIO_CAPTURE_OBJIF_PROGNAME
	string "Program name"
	default "audio_capture_objif"

config EXAMPLES_AUDIO_CAPTURE_OBJIF_PRIORITY
	int "Audio capture task priority"
	default 150

config EXAMPLES_AUDIO_CAPTURE_OBJIF_STACKSIZE
	int "Audio capture stack size"
	default 2048

endif
```

## examples/audio_player/Kconfig
```kconfig
#
# For a description of the syntax of this configuration file,
# see the file kconfig-language.txt in the NuttX tools repository.
#

config EXAMPLES_AUDIO_PLAYER
	bool "Audio player example"
	default n
	select AUDIOUTILS_PLAYER
	depends on CXD56_AUDIO
	---help---
		Enable the audio player example

if EXAMPLES_AUDIO_PLAYER

config EXAMPLES_AUDIO_PLAYER_APP_NAME
	string "Application name"
	default "player"
	
config EXAMPLES_AUDIO_PLAYER_PROGNAME
	string "Program name"
	default "audio_player"

config EXAMPLES_AUDIO_PLAYER_PRIORITY
	int "Audio player task priority"
	default 150

config EXAMPLES_AUDIO_PLAYER_STACKSIZE
	int "Audio player stack size"
	default 2048

config EXAMPLES_AUDIO_PLAYER_FILE_MOUNTPT
	string "play file mount path"
	default "/mnt/vfat/AUDIO"
	---help---
		The path to the play file mount point. Default: /mnt/vfat/AUDIO

config EXAMPLES_AUDIO_PLAYER_USE_SUBPLAYER
    bool "Use subplayer" 
    default n
    ---help---
        Use subplayer or not
endif
```

## examples/audio_recorder/Kconfig
```kconfig
#
# For a description of the syntax of this configuration file,
# see the file kconfig-language.txt in the NuttX tools repository.
#

config EXAMPLES_AUDIO_RECORDER
	bool "Audio recorder example"
	default n
	depends on CXD56_AUDIO
	---help---
		Enable the audio player example

if EXAMPLES_AUDIO_RECORDER

config EXAMPLES_AUDIO_RECORDER_APP_NAME
	string "Application name"
	default "recorder"
	
config EXAMPLES_AUDIO_RECORDER_PROGNAME
	string "Program name"
	default "audio_recorder"

config EXAMPLES_AUDIO_RECORDER_PRIORITY
	int "Audio recorder task priority"
	default 100

config EXAMPLES_AUDIO_RECORDER_STACKSIZE
	int "Audio recorder stack size"
	default 2048

config EXAMPLES_AUDIO_RECORDER_FILE_MOUNTPT
	string "recording file mount path"
	default "/mnt/sd0/REC"
	---help---
		The path to the recording file mount point. Default: /mnt/sd0/REC

endif
```

## examples/epaper/Kconfig
```kconfig
#
# For a description of the syntax of this configuration file,
# see the file kconfig-language.txt in the NuttX tools repository.
#

config EXAMPLES_EPAPER
	bool "ePaper \"Hello, World!\" example"
	default n
	---help---
		Enable the ePaper \"Hello, World!\" example

if EXAMPLES_EPAPER

config EXAMPLES_EPAPER_VPLANE
	int "Video Plane"
	default 0
	---help---
		The plane to select from the framebuffer driver for use in the test.
		Default: 0

config EXAMPLES_EPAPER_DEVNO
	int "Video Device Number"
	default 0
	---help---
		The LCD device to select from the LCD driver for use in the test:
		Default: 0

config EXAMPLES_EPAPER_BPP
	int "Bits-Per-Pixel"
	default 8
	---help---
		Pixels per pixel to use.  Valid options include 1, 2, 4, 8, 16, 24,
		and 32.


comment "Example Color Configuration"

config EXAMPLES_EPAPER_DEFAULT_COLORS
	bool "Use Default Colors"
	default y

if !EXAMPLES_EPAPER_DEFAULT_COLORS

config EXAMPLES_EPAPER_BGCOLOR
	hex "Background color"
	default 0x0
	---help---
		The color of the background.  Default depends on config
		EXAMPLES_EPAPER_BPP.

config EXAMPLES_EPAPER_FONTCOLOR
	hex "Background font color"
	default 0x0
	---help---
		The color of the fonts used in the background window. Default
		depends on config EXAMPLES_EPAPER_BPP.

endif

comment "Example Font Configuration"

config EXAMPLES_EPAPER_DEFAULT_FONT
	bool "Use Default Font"
	default y

if !EXAMPLES_EPAPER_DEFAULT_FONT

config EXAMPLES_EPAPER_FONTID
	int "Background font ID"
	default 0
	---help---
		Selects the font used in the background window (see font ID numbers
		in include/nuttx/nx/nxfonts.h)

endif

endif
```

## examples/fft/Kconfig
```kconfig
#
# For a description of the syntax of this configuration file,
# see the file kconfig-language.txt in the NuttX tools repository.
#

config EXAMPLES_FFT
	bool "FFT Example"
	default n
	---help---
		Fast Fourier Transform offload to DSP

if EXAMPLES_FFT

config EXAMPLES_FFT_DSPMATH_PATH
	string "DSP Math library executable"
	default "/mnt/vfat/BIN/DSPMATH"

config EXAMPLES_FFT_DISABLE_MATH_OFFLOAD
	bool "Disable offload math functions"
	default n
	---help---
		Disable offloading CMSIS math library functions.
		This option will be CMSIS DSP library linked directly.
		It is used for debug purpose only.

config EXAMPLES_FFT_WORKER_STACKSIZE
    int "Example worker stack size"
    default 1024

endif
```

## examples/gnss_atcmd/Kconfig
```kconfig
#
# For a description of the syntax of this configuration file,
# see the file kconfig-language.txt in the NuttX tools repository.
#

config EXAMPLES_GNSS_ATCMD
	bool "GNSS CXD5603 @command emulator example"
	default n
  select LIBC_FLOATINGPOINT
  #depends on CXD56_GNSS && CDCACM
  depends on CXD56_GNSS
	---help---
		Enable GNSS CXD5603 @command emulator example

if EXAMPLES_GNSS_ATCMD

config EXAMPLES_GNSS_ATCMD_PROGNAME
	string "Program name"
	default "gnss_atcmd"
	#depends on BUILD_KERNEL
	---help---
		This is the name of the program that will be use when the NSH ELF
		program is installed.

config EXAMPLES_GNSS_ATCMD_SUPPORT_SPECRUM
  bool "Example supports spectrum output"
  default y

config EXAMPLES_GNSS_ATCMD_PRIORITY
	int "GNSS task priority"
	default 100

config EXAMPLES_GNSS_ATCMD_STACKSIZE
	int "GNSS stack size"
	default 2048

endif
```

## examples/http_get/Kconfig
```kconfig
#
# For a description of the syntax of this configuration file,
# see the file kconfig-language.txt in the NuttX tools repository.
#

config EXAMPLES_HTTP_GET
	bool "http GET method example"
	default n
	select NETUTILS_HTTPC
	select NETUTILS_MBEDTLS
	select LTE_CLIENT
	---help---
		Enable the http_get Interface

if EXAMPLES_HTTP_GET

config EXAMPLES_HTTP_GET_PROGNAME
	string "Program name"
	default "http_get"
	depends on BUILD_KERNEL
	---help---
		This is the name of the program that will be use when the NSH ELF
		program is installed.

config EXAMPLES_HTTP_GET_PRIORITY
	int "http_get task priority"
	default 100
	---help---
		This is task priority of http_get example

config EXAMPLES_HTTP_GET_STACKSIZE
	int "http_get stack size"
	default 5120
	---help---
		This is task stack size of http_get example
endif
```

## examples/http_post/Kconfig
```kconfig
#
# For a description of the syntax of this configuration file,
# see the file kconfig-language.txt in the NuttX tools repository.
#

config EXAMPLES_HTTP_POST
	bool "http POST method example"
	default n
	select NETUTILS_HTTPC
	select NETUTILS_MBEDTLS
	select LTE_CLIENT
	---help---
		Enable the http_post Interface

if EXAMPLES_HTTP_POST

config EXAMPLES_HTTP_POST_PROGNAME
	string "Program name"
	default "http_post"
	depends on BUILD_KERNEL
	---help---
		This is the name of the program that will be use when the NSH ELF
		program is installed.

config EXAMPLES_HTTP_POST_PRIORITY
	int "http_post task priority"
	default 100
	---help---
		This is task priority of http_post example

config EXAMPLES_HTTP_POST_STACKSIZE
	int "http_post stack size"
	default 5120
	---help---
		This is task stack size of http_post example
endif
```

## examples/httpc/Kconfig
```kconfig
#
# For a description of the syntax of this configuration file,
# see the file kconfig-language.txt in the NuttX tools repository.
#

config EXAMPLES_HTTPC
	bool "httpc example"
	default n
	select NETUTILS_HTTPC
	select NETUTILS_MBEDTLS
	---help---
		Enable the httpc Interface

if EXAMPLES_HTTPC

config EXAMPLES_HTTPC_PROGNAME
	string "Program name"
	default "httpc"
	depends on BUILD_KERNEL
	---help---
		This is the name of the program that will be use when the NSH ELF
		program is installed.

config EXAMPLES_HTTPC_PRIORITY
	int "httpc test task priority"
	default 100
	---help---
		This is task priority of httpc example

config EXAMPLES_HTTPC_STACKSIZE
	int "httpc test stack size"
	default 2048
	---help---
		This is task stack size of httpc example
endif
```

## examples/location/Kconfig
```kconfig
#
# For a description of the syntax of this configuration file,
# see the file kconfig-language.txt in the NuttX tools repository.
#

config EXAMPLES_LOCATION
	bool "Location manager example"
	default n
	select LIBC_FLOATINGPOINT
	select LOCATION_MANAGER
	---help---
		Enable the location manager Interface

if EXAMPLES_LOCATION

config EXAMPLES_LOCATION_PROGNAME
	string "Program name"
	default "location"
	depends on BUILD_KERNEL
	---help---
		This is the name of the program that will be use when the NSH ELF
		program is installed.

config EXAMPLES_LOCATION_PRIORITY
	int "Location manager test task priority"
	default 100

config EXAMPLES_LOCATION_STACKSIZE
	int "Location manager test stack size"
	default 2048

endif
```

## examples/lte/Kconfig
```kconfig
#
# For a description of the syntax of this configuration file,
# see the file kconfig-language.txt in the NuttX tools repository.
#

config EXAMPLES_LTE
	bool "LTE example"
	default n
	---help---
		Enable the LTE example

if EXAMPLES_LTE

config EXAMPLES_LTE_PROGNAME
	string "Program name"
	default "lte"
	depends on BUILD_KERNEL
	---help---
		This is the name of the program that will be use when the NSH ELF
		program is installed.

config EXAMPLES_LTE_PRIORITY
	int "lte task priority"
	default 100

config EXAMPLES_LTE_STACKSIZE
	int "lte stack size"
	default 2048

config EXAMPLES_LTE_APN_NAME
	string "Access Point Name"
	default ""

config EXAMPLES_LTE_APN_IPTYPE
	int "IP type"
	default 0
	range 0 2
	---help---
		IP type is selected from IP, IPv6 and IPv4/v6.
		Values are IP=0, IPv6=1 and IPv4/v6=2.

config EXAMPLES_LTE_APN_AUTHTYPE
	int "Authentication type"
	default 0
	range 0 2
	---help---
		Authentication type is selected from NONE, PAP and CHAP.
		Values are NONE=0, PAP=1, CHAP=2.

config EXAMPLES_LTE_APN_USERNAME
	string "Username used for authentication"
	default ""

config EXAMPLES_LTE_APN_PASSWD
	string "Password used for authentication"
	default ""

endif
```

## examples/mqtt/Kconfig
```kconfig
#
# For a description of the syntax of this configuration file,
# see the file kconfig-language.txt in the NuttX tools repository.
#

config EXAMPLES_MQTT
	bool "mqtt example"
	default n
	select NETUTILS_MQTT
	select NETUTILS_MBEDTLS
	---help---
		Enable the mqtt Interface

if EXAMPLES_MQTT

config EXAMPLES_MQTT_PROGNAME
	string "Program name"
	default "mqtt"
	depends on BUILD_KERNEL
	---help---
		This is the name of the program that will be use when the NSH ELF
		program is installed.

config EXAMPLES_MQTT_PRIORITY
	int "mqtt test task priority"
	default 100

config EXAMPLES_MQTT_STACKSIZE
	int "mqtt test stack size"
	default 2048

endif
```

## examples/streaming/Kconfig
```kconfig
#
# For a description of the syntax of this configuration file,
# see the file kconfig-language.txt in the NuttX tools repository.
#

config EXAMPLES_STREAMING
	bool "streaming example"
	default n
	select LTE
	select NETUTILS_HTTPC
	select LIB_ASMP
	select SDK_AUDIO
	select AUDIOUTILS_MANAGER
	select AUDIOUTILS_PLAYER
	select MEMUTILS
	select MEMUTILS_MEMORY_MANAGER
	select MEMUTILS_MESSAGE
	select MEMUTILS_SIMPLE_FIFO
	---help---
		Enable the streaming Interface

if EXAMPLES_STREAMING

config EXAMPLES_STREAMING_PROGNAME
	string "Program name"
	default "streaming"
	depends on BUILD_KERNEL
	---help---
		This is the name of the program that will be use when the NSH ELF
		program is installed.

config EXAMPLES_STREAMING_PRIORITY
	int "streaming test task priority"
	default 100

config EXAMPLES_STREAMING_STACKSIZE
	int "streaming stack size"
	default 4096

endif
```

## examples/tracker/Kconfig
```kconfig
#
# For a description of the syntax of this configuration file,
# see the file kconfig-language.txt in the NuttX tools repository.
#

config EXAMPLES_TRACKER
	bool "Tracker example"
	default n
	select LIBC_FLOATINGPOINT
	select LOCATION_MANAGER
	select EXTNETUTILS
	select EXTNETUTILS_JSON
	select NETUTILS_HTTPC
	select NETUTILS_MBEDTLS
	select LTE
	select LTE_CLIENT

if EXAMPLES_TRACKER

config EXAMPLES_TRACKER_PROGNAME
	string "Program name"
	default "tracker"
	depends on BUILD_KERNEL
	---help---
		This is the name of the program that will be use when the NSH ELF
		program is installed.

config EXAMPLES_TRACKER_PRIORITY
	int "Tracker task priority"
	default 100

config EXAMPLES_TRACKER_STACKSIZE
	int "Tracker stack size"
	default 5120

config EXAMPLES_TRACKER_HTTP_CUSTOM_HEADER_NUM
	int "Max number of custom headers"
	default 5

config EXAMPLES_TRACKER_USING_EVENT_TRIGGER
	bool "Using event driven method"
	default n

if EXAMPLES_TRACKER_USING_EVENT_TRIGGER

config EXAMPLES_TRACKER_TAP_TRIGGER
	bool "Triggered by TAP detection"
	default y
	select HAVE_CXX
	select HAVE_CXXINITIALIZE
	select TAP
	select TAP_MANAGER

config EXAMPLES_TRACKER_BUTTON_TRIGGER
	bool "Triggered by button detection"
	default n
	select ARCH_BUTTONS
	select ARCH_IRQBUTTONS

endif

config EXAMPLES_TRACKER_USING_NXFB
	bool "Using NX graphics with frame buffer"
	default n

endif
```

## examples/volte/Kconfig
```kconfig
#
# For a description of the syntax of this configuration file,
# see the file kconfig-language.txt in the NuttX tools repository.
#

config EXAMPLES_VOLTE
	bool "volte example"
	default n
	select NET_LWIP
	select LTE
	select SDK_AUDIO
	select AUDIOUTILS_PLAYER
	select AUDIOUTILS_VOICE_CALL
	select HAVE_CXX
	select HAVE_CXXINITIALIZE
	select MEMUTILS_MEMORY_MANAGER
	select MEMUTILS_MESSAGE
	select MEMUTILS_SIMPLE_FIFO
	select LIB_ASMP
	---help---
		Enable the VoLTE Interface

if EXAMPLES_VOLTE

config EXAMPLES_VOLTE_PROGNAME
	string "Program name"
	default "volte"
	depends on BUILD_KERNEL
	---help---
		This is the name of the program that will be use when the NSH ELF
		program is installed.

config EXAMPLES_VOLTE_PRIORITY
	int "volte test task priority"
	default 100

config EXAMPLES_VOLTE_STACKSIZE
	int "volte test stack size"
	default 4096

endif
```

## externals/cmsis/Kconfig
```kconfig
#
# For a description of the syntax of this configuration file,
# see the file kconfig-language.txt in the NuttX tools repository.
#

config EXTERNALS_CMSIS
	bool "CMSIS Libraries"
	default n
	---help---
		Enable CMSIS Libraries.
		The Cortex Microcontroller Software Interface Standard (CMSIS) is provided
		from https://github.com/ARM-software/CMSIS_5 and licensed under Apache-2.0.
		For details, see http://arm-software.github.io/CMSIS_5/General/html/index.html.

if EXTERNALS_CMSIS

config EXTERNALS_CMSIS_DSP
	bool "CMSIS DSP"
	default y
	---help---
		Enable CMSIS-DSP: Fast implementation of digital signal processing.

config EXTERNALS_CMSIS_NN
	bool "CMSIS NN"
	default y
	depends on EXTERNALS_CMSIS_DSP
	---help---
		Enable CMSIS-NN: Efficient neural network kernels.

endif
```

## sdk/Kconfig
```kconfig
#
# For a description of the syntax of this configuration file,
# see the file kconfig-language.txt in the NuttX tools repository.
#

mainmenu "Spookie (tentative) SDK Configuration"

source bsp/Kconfig
source drivers/Kconfig
source modules/Kconfig
```

## sdk/bsp/Kconfig
```kconfig
#
# For a description of the syntax of this configuration file,
# see the file kconfig-language.txt in the NuttX tools repository.
#

menu "Board Configuration"

choice
	prompt "Board Selection"
	default BOARD_CORVO

	config BOARD_CORVO
		bool "Corvo"

	config BOARD_COLLET
		bool "Collet"

endchoice

config BOARD_NAME
	string
	default "corvo" if BOARD_CORVO
	default "collet" if BOARD_COLLET

endmenu
```
