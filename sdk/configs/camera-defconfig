## sdk/configs/camera-defconfig
```kconfig
CONFIG_CXD56_CISIF=y
CONFIG_VIDEO_DEVICES=y
CONFIG_VIDEO_ISX012=y
CONFIG_EXAMPLES_CAMERA=y
```

## sdk/configs/device/bh1721fvc-defconfig
```kconfig
CONFIG_CXD56_I2C=y
CONFIG_CXD56_I2C0=y
CONFIG_SENSORS=y
CONFIG_BH1721FVC=y
CONFIG_EXAMPLES_LIGHT=y
```

## sdk/configs/device/modem-defconfig
```kconfig
CONFIG_CXD56_SPI=y
CONFIG_CXD56_SPI5=y
CONFIG_CXD56_DMAC_SPI5_TX=y
CONFIG_CXD56_DMAC_SPI5_TX_MAXSIZE=2064
CONFIG_CXD56_DMAC_SPI5_RX=y
CONFIG_CXD56_DMAC_SPI5_RX_MAXSIZE=2064
CONFIG_MODEM=y
```

## sdk/configs/feature/lte-defconfig
```kconfig
CONFIG_LTE=y
CONFIG_LTE_NET=y
CONFIG_LTE_INET=y
CONFIG_LTE_INET_ATON=y
CONFIG_LTE_NETDB=y
```

## sdk/configs/gnss_examples-defconfig
```kconfig
CONFIG_GPSUTILS_CXD56NMEA_LIB=y
CONFIG_EXAMPLES_GEOFENCE=y
CONFIG_EXAMPLES_GNSS=y
CONFIG_EXAMPLES_GNSS_ATCMD=y
CONFIG_EXAMPLES_GNSS_FACTORY=y
CONFIG_EXAMPLES_GNSS_PVTLOG=y
```

## sdk/configs/kernel/nsh-defconfig
```kconfig
# CONFIG_NSH_ARGCAT is not set
# CONFIG_NSH_CMDOPT_DF_H is not set
# CONFIG_NSH_CMDOPT_HEXDUMP is not set
# CONFIG_NSH_CMDPARMS is not set
# CONFIG_STANDARD_SERIAL is not set
CONFIG_ARCH="arm"
CONFIG_ARCH_BOARD="cxd56-corvo"
CONFIG_ARCH_BOARD_CXD56_CORVO=y
CONFIG_ARCH_CHIP_CXD56XX=y
CONFIG_ARCH_STACKDUMP=y
CONFIG_ARMV7M_USEBASEPRI=y
CONFIG_BOARDCTL_IOCTL=y
CONFIG_BOARDCTL_POWEROFF=y
CONFIG_BOARDCTL_RESET=y
CONFIG_BOARDCTL_UNIQUEID=y
CONFIG_BOARDCTL_USBDEVCTRL=y
CONFIG_BOARD_LOOPSPERMSEC=5434
CONFIG_BOOT_RUNFROMISRAM=y
CONFIG_BUILTIN=y
CONFIG_CDCACM=y
CONFIG_CLOCK_MONOTONIC=y
CONFIG_CXD56_I2C0=y
CONFIG_CXD56_I2C1=y
CONFIG_CXD56_I2C2=y
CONFIG_CXD56_RTC=y
CONFIG_CXD56_SPI0=y
CONFIG_CXD56_SPI3=y
CONFIG_CXD56_SPI4=y
CONFIG_CXD56_SPI5=y
CONFIG_DEBUG_FULLOPT=y
CONFIG_DEBUG_SYMBOLS=y
CONFIG_ELF=y
CONFIG_EXAMPLES_NSH=y
CONFIG_EXAMPLES_NSH_CXXINITIALIZE=y
CONFIG_FS_FAT=y
CONFIG_FS_PROCFS=y
CONFIG_FS_ROMFS=y
CONFIG_HAVE_CXX=y
CONFIG_HAVE_CXXINITIALIZE=y
CONFIG_I2C=y
CONFIG_LIBM=y
CONFIG_LIB_KBDCODEC=y
CONFIG_MAX_TASKS=16
CONFIG_MAX_WDOGPARMS=2
CONFIG_MTD=y
CONFIG_NFILE_DESCRIPTORS=8
CONFIG_NFILE_STREAMS=8
CONFIG_NSH_ARCHINIT=y
CONFIG_NSH_BUILTIN_APPS=y
CONFIG_NSH_DISABLE_DATE=y
CONFIG_NSH_FILEIOSIZE=512
CONFIG_NSH_LINELEN=64
CONFIG_NSH_READLINE=y
CONFIG_PREALLOC_MQ_MSGS=4
CONFIG_PREALLOC_TIMERS=4
CONFIG_PREALLOC_WDOGS=16
CONFIG_RAM_SIZE=1572864
CONFIG_RAM_START=0x0d000000
CONFIG_RR_INTERVAL=200
CONFIG_RTC=y
CONFIG_RTC_ALARM=y
CONFIG_RTC_DRIVER=y
CONFIG_RTC_FREQUENCY=32768
CONFIG_RTC_HIRES=y
CONFIG_SCHED_WAITPID=y
CONFIG_SDCLONE_DISABLE=y
CONFIG_SPI=y
CONFIG_START_DAY=6
CONFIG_START_MONTH=12
CONFIG_START_YEAR=2011
CONFIG_TIMER=y
CONFIG_UART1_SERIAL_CONSOLE=y
CONFIG_USBDEV=y
CONFIG_USBMSC=y
CONFIG_USER_ENTRYPOINT="nsh_main"
CONFIG_WATCHDOG=y
```

## sdk/configs/lte-defconfig
```kconfig
CONFIG_MODEM=y
CONFIG_MODEM_ALT_1160=y
CONFIG_CXD56_GNSS=y
CONFIG_GPSUTILS_CXD56NMEA_LIB=y
CONFIG_LTE=y
CONFIG_NET_LWIP=y
CONFIG_EXAMPLES_LTE=y
```

## sdk/configs/spresense_dvt-defconfig
```kconfig
CONFIG_BOARD_SPRESENSE=y
CONFIG_AUDIOUTILS_PLAYLIST_PLAYLISTFILE_MOUNTPT="/mnt/spif/PLAYLIST"
CONFIG_AUDIOUTILS_PLAYLIST_PLAYFILE_MOUNTPT="/mnt/spif/AUDIO"
CONFIG_AUDIOUTILS_DSP_MOUNTPT="/mnt/spif/BIN"
```

## sdk/drivers/Kconfig
```kconfig
menu "Drivers"

source "$SDKDIR/drivers/sensors/Kconfig"
source "$SDKDIR/drivers/lcd/Kconfig"

endmenu
```

## sdk/drivers/lcd/Kconfig
```kconfig
#
# For a description of the syntax of this configuration file,
# see the file kconfig-language.txt in the NuttX tools repository.
#

menuconfig LCD
	bool "LCD Drivers"
	---help---
		LCD and EInk display device drivers.

if LCD

config LCD_LPM013M091A
	bool "JDI LPM013M091A LCD Driver"
	default n
#	select LCD_NOGETRUN
	---help---
		JDI LPM013M091A LCD Driver.
		This driver doesn't support reading data.
		Recommended to use DMA to transfer data or displayed image would be
		broken.

config LCD_ET014TT1
	bool "EInk ET014TT1 ePaper"
	default n
	---help---
		Supports the E Ink ET014TT1 1.43 inch monochrome display.

endif
```

## sdk/drivers/modem/Kconfig
```kconfig
#
# For a description of the syntax of this configuration file,
# see the file kconfig-language.txt in the NuttX tools repository.
#

menuconfig MODEM
	bool "MODEM drivers"
	---help---
		MODEM device drivers.

if MODEM

config MODEM_ALT_1160
	bool "Altair ALT1160 modem support"
	default n
	---help---
		Enable driver for the Altiar ALT1160 modem.

config MODEM_ALT_1160_PROTCOL_V2_1
	bool "Enable SPI protocol version 2.1"
	default y
	depends on MODEM_ALT_1160
	---help---
		Support only this version.

config MODEM_ALT_1160_DEBUG
	bool "Enable debug mode for ALT1160 modem driver"
	default n
	depends on MODEM_ALT_1160
	---help---
		Allow the alt1160 modem driver print debug information.

config MODEM_ALT_1160_BOOT_DELAY
	int "Delay time during ALT1160 startup in sec"
	default 10
	depends on MODEM_ALT_1160
	---help---
		none

config MODEM_ALT_1160_KEEP_WAKE_STATE
	bool "Configuration to keep wake state of ALT1160"
	default n
	depends on MODEM_ALT_1160
	---help---
		none

endif
```

## sdk/drivers/sensors/Kconfig
```kconfig
#
# For a description of the syntax of this configuration file,
# see the file kconfig-language.txt in the NuttX tools repository.
#

menuconfig SENSORS
	bool "Sensor Drivers"

if SENSORS

config BMI160
	bool "Bosch BMI160 Sensor support"
	default n
	---help---
		Enable driver support for the Bosch BMI160 sensor.

config BMP280
	bool "Bosch BMP280 Barometic Pressure Sensor"
	default n
	select I2C
	---help---
		Enable driver for the Bosch BMP280 barometic pressure sensor.

config AK09912
	bool "Asahi AK09912 Compass Sensor"
	default n
	select I2C
	---help---
		Enable driver for AK09912 Compass sensor.

config APDS9930
	bool "Avago APDS9930 Proximity and Ambient light Sensor"
	default n
	select I2C
	---help---
		Enable driver for APDS9930 proximity and ambient light sensor.

if APDS9930

config APDS9930_PROXIMITY_INTERRUPT
	bool "Use Proximity interrupt"
	default y
	---help---
		Use Interrupt when the threshold is exceeded.
		In this case, SCU sequencer is not used.

endif

config LT1PA01
	bool "Murata LT1PA01 Proximity and Ambient light Sensor"
	default n
	select I2C
	---help---
		Enable driver for LT1PA01 proximity and ambient light sensor.

if LT1PA01

config LT1PA01_PROXIMITY_INTERRUPT
	bool "Use Proximity interrupt"
	default y
	---help---
		Use Interrupt when the threshold is exceeded.
		In this case, SCU sequencer is not used.

endif

config BH1721FVC
	bool "Rohm BH1721FVC Ambient Light Sensor"
	default n
	select I2C
	---help---
		Enable driver for the Rohm BH1721FVC light sensor.

config KX022
	bool "Kionix KX022 Acceleration Sensor"
	default n
	select I2C
	---help---
		Enable driver for the Kionix KX0222 acceleration sensor.

config BM1422GMV
	bool "Rohm BM1422GMV Magnetic Sensor"
	default n
	select I2C
	---help---
		Enable driver for BM1422GMV magnetic sensor.

config BM1383GLV
	bool "Rohm BM1383GLV Pressure Sensor"
	default n
	select I2C
	---help---
		Enable driver for BM1383GLV pressure sensor.

config BH1745NUC
	bool "Rohm BH1745NUC Color Sensor"
	default n
	select I2C
	---help---
		Enable driver for BH1745NUC color sensor.

config RPR0521RS
	bool "Rohm RPR0521RS Proximity and Ambient light Sensor"
	default n
	select I2C
	---help---
		Enable driver for RPR0521RS proximity and ambient light sensor.

if RPR0521RS

config RPR0521RS_PROXIMITY_INTERRUPT
	bool "Use Proximity interrupt"
	default y
	---help---
		Use Interrupt when the threshold is exceeded.
		In this case, SCU sequencer is not used.

endif

endif # SENSORS
```
