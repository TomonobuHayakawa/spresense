## sdk/modules/Kconfig
```kconfig
#
# For a description of the syntax of this configuration file,
# see the file kconfig-language.txt in the NuttX tools repository.
#

source modules/sensing/Kconfig
source modules/audio/Kconfig
source modules/memutils/Kconfig
source modules/asmp/Kconfig
source modules/lte/Kconfig
source modules/nfc/Kconfig
source modules/cmdfw/Kconfig
source modules/net/Kconfig
source modules/netutils/Kconfig
source modules/fwuputils/Kconfig
source modules/location/Kconfig
```

## sdk/modules/asmp/Kconfig
```kconfig
menuconfig ASMP
	bool "ASMP"
	help
		A hybrid multi processor framework

if ASMP
	config MM_TILE
	bool
	default y

	config ASMP_MEMSIZE
	hex "Memory size"
	default 0x80000
	help
		Memory size for shared memory area in ASMP Framework.

endif
```

## sdk/modules/audio/components/Kconfig
```kconfig
#
# For a description of the syntax of this configuration file,
# see the file kconfig-language.txt in the NuttX tools repository.
#

config AUDIOUTILS_CAPTURE
	bool "Capture"
	default n
	---help---
		Enable Capture Feature

config AUDIOUTILS_DECODER
	bool "Decoder"
	default n
	---help---
		Enable Decode Feature

config AUDIOUTILS_ENCODER
	bool "Encoder"
	default n
	---help---
		Enable Encode Feature

config AUDIOUTILS_FILTER
	bool "Fileter"
	default n
	---help---
		Enable Filtering Feature

config AUDIOUTILS_RECOGNITION
	bool "Recognition"
	default n
	---help---
		Enable Recognition Feature

config AUDIOUTILS_RENDERER
	bool "Renderer"
	default n
	---help---
		Enable Renderer Feature

config AUDIOUTILS_COMPONENT_COMMON
	bool
	default y if AUDIOUTILS_DECODER || AUDIOUTILS_FILTER

config AUDIOUTILS_DSP_DEBUG_DUMP
	bool "dsp debug dump"
	default n
	depends on CXD56_BACKUPLOG
	---help---
		Enable Dsp Debug Dump
```

## sdk/modules/audio/playlist/Kconfig
```kconfig
#
# For a description of the syntax of this configuration file,
# see the file kconfig-language.txt in the NuttX tools repository.
#

config AUDIOUTILS_PLAYLIST
	bool "Playlist manager"
	default n
	---help---
		Enable support for playlist manager.

if AUDIOUTILS_PLAYLIST

config AUDIOUTILS_PLAYLIST_PLAYLISTFILE_MOUNTPT
	string "playlist file mount path"
	default "/mnt/sd0/PLAYLIST"
	---help---
		The path to the playlist file mount point. Default: /mnt/sd0/PLAYLIST

config AUDIOUTILS_PLAYLIST_PLAYFILE_MOUNTPT
	string "play file mount path"
	default "/mnt/sd0/AUDIO"
	---help---
		The path to the play file mount point. Default: /mnt/sd0/AUDIO

endif #AUDIOUTILS_PLAYLIST
```

## sdk/modules/bluetooth/Kconfig
```kconfig
#
# For a description of the syntax of this configuration file,
# see the file kconfig-language.txt in the NuttX tools repository.
#

menu "Bluetooth Support"

config BLUETOOTH
	bool "Bluetooth Framework Support"
	default n
	---help---
		Enable Bluetooth framework. This option not contain HAL configuration, so
		if you use bluetooth function, please enable HAL configuration what you
		want to use.

endmenu
```

## sdk/modules/bluetooth/hal/bcm20706/Kconfig
```kconfig
#
# For a description of the syntax of this configuration file,
# see the file kconfig-language.txt in the NuttX tools repository.
#


config BCM20706
	bool "Cypress BCM20706 bluetooth"
	default n
	---help---
		Enable Cypress BCM20706 HALs.

if BCM20706
config BCM20706_A2DP
	bool
	default BLUETOOTH_A2DP
	---help---
		This option enabling Cypress BCM20706 A2DP HAL.

config BCM20706_AVRCP
	bool
	default BLUETOOTH_AVRCP
	---help---
		This option enabling Cypress BCM20706 AVRCP HAL.

config BCM20706_HFP
	bool
	default BLUETOOTH_HFP
	---help---
		This option enabling Cypress BCM20706 HFP HAL.

config BCM20706_SPP
	bool
	default BLUETOOTH_SPP
	---help---
		This option enabling Cypress BCM20706 SPP HAL.

config BCM20706_LE
	bool
	default BLUETOOTH_LE
	---help---
		This option enabling Cypress BCM20706 Low Energy HAL.

if BCM20706_LE
config BCM20706_LE_GATT
	bool
	default BLUETOOTH_LE_GATT
	---help---
		This option enabling Cypress BCM20706 LE GATT HAL.
endif
endif
```

## sdk/modules/cmdfw/Kconfig
```kconfig
#
# For a description of the syntax of this configuration file,
# see the file kconfig-language.txt in the NuttX tools repository.
#

menu "Spritzer Command Fw"

config CMDFW 
	bool "Spritzer Command utilities framework"
	default n
	select MEMUTILS_SIMPLE_FIFO
	select FWUPUTILS_MANAGER
	select FWUPUTILS_CLIENTS
	---help---

if CMDFW

config SPCOMMAND_ENABLE_CRCCHECK
    bool "Command FW CRC check enable"
    default n 
    ---help---

config SPCOMMAND_ENABLE_SEQNO
    bool "Command FW sequence number enable"
    default y
    ---help---

config SPCOMMAND_PACKET_BUFFER_SIZE
    hex "Size of buffer for store packet which would like to parse"
    default 0x1000
    ---help---

config SPCOMMAND_FWUPDATE_WORK_AREA_SIZE
	hex "FW download work memory size"
	default 0x10000
	---help---

config SPCOMMAND_FWUPDATE_PACKAGE_DIR
	string "FW package place directory"
	default "/mnt/spif" 
	---help---

config DEBUG_COMMANDFW
	bool "Command FW Debug"
	default n
	---help---

endif

endmenu # Command Fw
```

## sdk/modules/location/Kconfig
```kconfig
#
# For a description of the syntax of this configuration file,
# see the file kconfig-language.txt in the NuttX tools repository.
#

menu "Location"

config LOCATION_MANAGER
	bool "Location manager"
	default n
	select CXD56_GNSS
	---help---
		Enable support for location manager.

endmenu # Location
```

## sdk/modules/lte/Kconfig
```kconfig
#
# For a description of the syntax of this configuration file,
# see the file kconfig-language.txt in the NuttX tools repository.
#

menu "LTE"

config LTE_CLI_LIB
	bool "LTE Client Library Support"
	default n
	---help---
		Enables support for the LTE client library.

endmenu # LTE Library
```

## sdk/modules/lte/client/Kconfig
```kconfig
#
# For a description of the syntax of this configuration file,
# see the file kconfig-language.txt in the NuttX tools repository.
#

config LTE_CLIENT
	bool "LTE Client Library Support"
	default n
	---help---
		Enables support for the LTE client library.
```

## sdk/modules/memutils/memory_manager/Kconfig
```kconfig
#
# For a description of the syntax of this configuration file,
# see the file kconfig-language.txt in the NuttX tools repository.
#

config MEMUTILS_MEMORY_MANAGER
	bool "Memory manager"
	default n
	---help---
		Enable support for memory manager.

if MEMUTILS_MEMORY_MANAGER
config NUM_FIXED_AREA_FENCES
	int "area fence num"
	default 0

endif
```

## sdk/modules/net/Kconfig
```kconfig
#
# For a description of the syntax of this configuration file,
# see the file kconfig-language.txt in the NuttX tools repository.
#

menu "NET"

config NET_LWIP
	bool "Networking support"
	select CLOCK_MONOTONIC
	default n
	---help---
		Enable or disable all network features

endmenu # NET
```

## sdk/modules/netutils/Kconfig
```kconfig
#
# For a description of the syntax of this configuration file,
# see the file kconfig-language.txt in the NuttX tools repository.
#

menuconfig EXTNETUTILS
	bool "Network Utilities"

if EXTNETUTILS

source "$SDKDIR/modules/netutils/mbedtls/Kconfig"
source "$SDKDIR/modules/netutils/httpc/Kconfig"
source "$SDKDIR/modules/netutils/mqtt/Kconfig"
source "$SDKDIR/modules/netutils/json/Kconfig"

endif
```

## sdk/modules/netutils/mbedtls/Kconfig
```kconfig
#
# For a description of the syntax of this configuration file,
# see the file kconfig-language.txt in the NuttX tools repository.
#

config NETUTILS_MBEDTLS
	bool "mbedTLS support"
	default n
	select NET_LWIP
	---help---
		Enable or disable mbedTLS features

if NETUTILS_MBEDTLS

config NETUTILS_MBEDTLS_SSL_MAX_CONTENT_LEN
	int "Maxium fragment length in bytes"
	default 16384
	---help---
		the RFC defines the default size of SSL / TLS messages. If you
		change the value here, other clients / servers may not be able to
		communicate with you anymore. Only change this value if you control
		both sides of the connection and have it reduced at both sides, or
		if you're using the Max Fragment Length extension and you know all your
		peers are using it too!

endif
```

## sdk/modules/netutils/mqtt/Kconfig
```kconfig
#
# For a description of the syntax of this configuration file,
# see the file kconfig-language.txt in the NuttX tools repository.
#

config NETUTILS_MQTT
	bool "MQTT support"
	default n
	select NET_LWIP
	---help---
		Enable or disable MQTT features
```

## sdk/modules/nfc/Kconfig
```kconfig
#
# For a description of the syntax of this configuration file,
# see the file kconfig-language.txt in the NuttX tools repository.
#

menu "NFC Support"

config LIBNFC
	bool "NFC library"
	default n
	---help---
		Enable or disable reader_hce.

config NFC_SEQUENCER
	bool "NFC Sequencer"
	default n
	---help---
		Enable or disable NFC sequencer.

endmenu # nfc Support
```

## sdk/modules/sensing/Kconfig
```kconfig
#
# For a description of the syntax of this configuration file,
# see the file kconfig-language.txt in the NuttX tools repository.
#

menu "Sensing"

config SENSING_MANAGER
	bool "Sensor manager"
	default n
	---help---
		Enable support for sensor manager.

if SENSING_MANAGER

config SENSING_MANAGER_POWERCTRL
	bool "Sensor manager power control enable"
	default n
	---help---
        To use SF_SendSensorSetPower() API, enable this.

endif

source "$SDKDIR/modules/sensing/gnss/Kconfig"
source "$SDKDIR/modules/sensing/arm_gesture/Kconfig"
source "$SDKDIR/modules/sensing/barometer/Kconfig"
source "$SDKDIR/modules/sensing/compass/Kconfig"
source "$SDKDIR/modules/sensing/tap/Kconfig"
source "$SDKDIR/modules/sensing/transport_mode/Kconfig"
source "$SDKDIR/modules/sensing/transport_mode_lite/Kconfig"
source "$SDKDIR/modules/sensing/voice_detection/Kconfig"

endmenu # Sensor Utilities
```

## sdk/modules/sensing/arm_gesture/Kconfig
```kconfig
#
# For a description of the syntax of this configuration file,
# see the file kconfig-language.txt in the NuttX tools repository.
#

config SENSORUTILS_ARMGESTURE
	bool "Arm gesture"
	default n
	---help---
		Enable support for arm gesture.
```

## sdk/modules/sensing/compass/Kconfig
```kconfig
#
# For a description of the syntax of this configuration file,
# see the file kconfig-language.txt in the NuttX tools repository.
#

config SENSORUTILS_COMPASS
	bool "Compass"
	default n
	---help---
		Enable support for compass.
```

## sdk/modules/sensing/transport_mode/Kconfig
```kconfig
#
# For a description of the syntax of this configuration file,
# see the file kconfig-language.txt in the NuttX tools repository.
#

config SENSING_TRAM
	bool "transport mode"
	default n
	select SENSING_MANAGER
	select SENSING_MANAGER_POWERCTRL
	---help---
		Enable support for transport mode.
```

## sdk/modules/sensing/transport_mode_lite/Kconfig
```kconfig
#
# For a description of the syntax of this configuration file,
# see the file kconfig-language.txt in the NuttX tools repository.
#

config SENSING_TRAMLITE
	bool "transport mode light version"
	default n
	select SENSING_MANAGER
	select SENSING_MANAGER_POWERCTRL
	---help---
		Enable support for transport mode light version.

if SENSING_TRAMLITE

config SENSING_TRAMLITE_LOW_LATENCY
	bool "Enable low latency mode"
	default n

endif
```

## sdk/modules/sensing/voice_detection/Kconfig
```kconfig
#
# For a description of the syntax of this configuration file,
# see the file kconfig-language.txt in the NuttX tools repository.
#

config SENSING_VAD
	bool "Voice Activity Detection"
	default n
	---help---
		Enable support for voice activity detection.
```
